## conf/local.conf
```bitbake
MACHINE = "qemuarm64"
IMAGE_INSTALL_append = " core-image-aesd "
SSTATE_DIR = "/home/william/Linux_programming_buildroot/assignment-6-willpfigueiredo/build/sstate-cache"
DL_DIR = "/home/william/Linux_programming_buildroot/assignment-6-willpfigueiredo/build/downloads"
```
